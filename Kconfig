## Kconfig
```kconfig
DT_COMPAT_ZMK_BEHAVIOR_INVERTING_KEY_PRESS := zmk,behavior-inverting-key-press

config ZMK_BEHAVIOR_INVERTING_KEY_PRESS
    bool
    default $(dt_compat_enabled,$(DT_COMPAT_ZMK_BEHAVIOR_INVERTING_KEY_PRESS))
```

## dts/bindings/behaviors/zmk,behavior-inverting-key-press.yaml
```yaml
# Copyright (c) 2025 Nicolas Munnich
# SPDX-License-Identifier: MIT

description: Inverting Key Press behavior

compatible: "zmk,behavior-inverting-key-press"

include: one_param.yaml
```
